## connectivity-domain/meta-infusion-pump/recipes-core/images/infusion-ab.wks
```
bootloader --ptable msdos

part /boot --source bootimg-partition --ondisk mmcblk0 --fstype=vfat --label boot --active --align 4 --size 64
part / --source rootfs --ondisk mmcblk0 --fstype=ext4 --label rootfsA --align 4 --size 1024
part none --ondisk mmcblk0 --fstype=ext4 --label rootfsB --align 4 --size 1024
part /data --ondisk mmcblk0 --fstype=ext4 --label data --align 4 --size 512
```
